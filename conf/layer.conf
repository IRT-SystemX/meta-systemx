## conf/layer.conf
```bitbake
# We have a conf and classes directory, add to BBPATH
BBPATH .= ":${LAYERDIR}"

# We have recipes-* directories, add to BBFILES
BBFILES += "${LAYERDIR}/recipes-*/*/*.bb \
            ${LAYERDIR}/recipes-*/*/*.bbappend"

BBFILE_COLLECTIONS += "systemx"
BBFILE_PATTERN_systemx := "^${LAYERDIR}/"
BBFILE_PRIORITY_systemx = "4"
LAYERVERSION_systemx = "1"
```
